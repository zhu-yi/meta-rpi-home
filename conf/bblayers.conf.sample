## conf/bblayers.conf.sample
```bitbake
# POKY_BBLAYERS_CONF_VERSION is increased each time build/conf/bblayers.conf
# changes incompatibly
POKY_BBLAYERS_CONF_VERSION = "2"

BBPATH = "${TOPDIR}"
BSPDIR := "${@os.path.abspath(os.path.dirname(d.getVar('FILE', True)) + '/../../..')}"
BBFILES ?= ""

BBLAYERS ?= " \
  ${BSPDIR}/poky/meta \
  ${BSPDIR}/poky/meta-poky \
  ${BSPDIR}/meta-openembedded/meta-oe \
  ${BSPDIR}/meta-openembedded/meta-multimedia \
  ${BSPDIR}/meta-openembedded/meta-perl \
  ${BSPDIR}/meta-raspberrypi \
  ${BSPDIR}/meta-lms \
  ${BSPDIR}/meta-rpi-home \
"

BBLAYERS_NON_REMOVABLE ?= " \
  ${BSPDIR}/poky/meta \
  ${BSPDIR}/poky/meta-poky \
"
```

## conf/distro/rpi-home.conf
```bitbake
include conf/distro/poky.conf

DISTRO = "rpi-home"
DISTRO_NAME = "RPI Home Linux"

DISTRO_FEATURES = " \
    alsa \
    bluetooth \
    bluez5 \
    ext2 \
    largefile \
    opengl \
    usbgadget \
    usbhost \
    ${DISTRO_FEATURES_LIBC} \
"
DISTRO_FEATURES_remove = "ipv6"

# use systemd instead of System V init
DISTRO_FEATURES += "systemd"
VIRTUAL-RUNTIME_init_manager = "systemd"
DISTRO_FEATURES_BACKFILL_CONSIDERED = "sysvinit"

# configuration to tweak config.txt and cmdline.txt for raspberry pi
RPI_USE_U_BOOT = "1"
ENABLE_UART = "1"
HDMI_FORCE_HOTPLUG = "1"
HDMI_DRIVE = "2"

RPI_EXTRA_CONFIG = ' \n \
    # Raspberry Pi 7\" display/touch screen \n \
    lcd_rotate=2 \n \
    \n \
    # Enable audio (loads snd_bcm2835) \n \
    dtparam=audio=on \n \
'
```

## conf/layer.conf
```bitbake
# We have a conf and classes directory, add to BBPATH
BBPATH .= ":${LAYERDIR}"

# We have recipes-* directories, add to BBFILES
BBFILES += "${LAYERDIR}/recipes-*/*/*.bb \
            ${LAYERDIR}/recipes-*/*/*.bbappend"

BBFILE_COLLECTIONS += "rpi-home"
BBFILE_PATTERN_rpi-home = "^${LAYERDIR}/"

# assign higher priority than meta-raspberrypi
BBFILE_PRIORITY_rpi-home = "10"
LAYERVERSION_rpi-home = "0"
LAYERSERIES_COMPAT_rpi-home = "sumo thud"
```
